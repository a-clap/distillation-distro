## build/conf/bblayers.conf
```bitbake
# POKY_BBLAYERS_CONF_VERSION is increased each time build/conf/bblayers.conf
# changes incompatibly
POKY_BBLAYERS_CONF_VERSION = "2"

BBPATH = "${TOPDIR}"
BBFILES ?= ""

BSPDIR := "${@os.path.abspath(os.path.dirname(d.getVar('FILE', True)) + '/../..')}"

BBLAYERS ?= " \
  ${BSPDIR}/src/meta-user \
  ${BSPDIR}/src/meta-sunxi \
  ${BSPDIR}/src/meta-openembedded/meta-oe \
  ${BSPDIR}/src/meta-openembedded/meta-python \
  ${BSPDIR}/src/poky/meta \
  ${BSPDIR}/src/poky/meta-poky \
  ${BSPDIR}/src/poky/meta-yocto-bsp \
  ${BSPDIR}/src/meta-arm/meta-arm \
  ${BSPDIR}/src/meta-arm/meta-arm-toolchain \
  "
```

## src/meta-mender-bananapi/meta-mender-core/conf/layer.conf
```bitbake
# We have a conf and classes directory, add to BBPATH
BBPATH .= ":${LAYERDIR}"

# We have recipes-* directories, add to BBFILES
BBFILES += "${LAYERDIR}/recipes-*/*/*.bb \
            ${LAYERDIR}/recipes-*/*/*.bbappend"

BBFILE_COLLECTIONS += "meta-mender-core"
BBFILE_PATTERN_meta-mender-core = "^${LAYERDIR}/"
BBFILE_PRIORITY_meta-mender-core = "12"

LAYERDEPENDS_meta-mender-core = "core"
LAYERSERIES_COMPAT_meta-mender-core = "mickledore"
LAYERSERIES_COMPAT_mender += "mickledore"
```

## src/meta-user/conf/distro/banan-common.conf
```bitbake
# We are extending poky
require conf/distro/poky.conf

DISTRO = "banan-common"
DISTRO_NAME = "banan-common"

DISTRO_VERSION = "1.0.0"

# systemd
DISTRO_FEATURES:append = " systemd x11 opengl"
DISTRO_FEATURES_BACKFILL_CONSIDERED += "sysvinit"

VIRTUAL-RUNTIME_init_manager = "systemd"
VIRTUAL-RUNTIME_initscripts = "systemd-compat-units"
```

## src/meta-user/conf/distro/bananapi-common.conf
```bitbake
# We are extending poky
require conf/distro/poky.conf

DISTRO = "bananapi-common"
DISTRO_NAME = "bananapi-common"

DISTRO_VERSION = "1.0.0"

PREFERRED_VERSION_linux-mainline = "6.%"

KERNEL_IMAGETYPE = "uImage"

# systemd
DISTRO_FEATURES:append = " x11 opengl"
DISTRO_FEATURES:remove = "vulkan ptest"

INIT_MANAGER = "systemd"
```

## src/meta-user/conf/distro/beagle-common.conf
```bitbake
# We are extending poky
require conf/distro/poky.conf

DISTRO = "beagle-common"
DISTRO_NAME = "Common beagle distro config"

DISTRO_VERSION = "1.0.0"

# systemd
DISTRO_FEATURES:append = " systemd"
DISTRO_FEATURES_BACKFILL_CONSIDERED += "sysvinit"

VIRTUAL-RUNTIME_init_manager = "systemd"
VIRTUAL-RUNTIME_initscripts = "systemd-compat-units"

PREFERRED_PROVIDER_virtual/kernel ??= "linux-yocto"
PREFERRED_VERSION_linux-yocto-rt ??= "5.15%"
```

## src/meta-user/conf/distro/beagle-deb.conf
```bitbake
# Use common config
require beagle-common.conf

DISTRO = "beagle-deb"
DISTRO_NAME = "Beaglebone with DEB support"

DISTRO_VERSION = "1.0.0"

PACKAGE_CLASSES = "deb"
```

## src/meta-user/conf/distro/beagle-gpu.conf
```bitbake
# Use common config
require beagle-common.conf

DISTRO = "beagle-gpu"
DISTRO_NAME = "Beaglebone with hardware GPU acceleration"

DISTRO_VERSION = "1.0.0"

PREFERRED_PROVIDER_virtual/egl = "ti-sgx-ddk-um"
PREFERRED_PROVIDER_virtual/libgles1 = "ti-sgx-ddk-um"
PREFERRED_PROVIDER_virtual/libgles2 = "ti-sgx-ddk-um"
PREFERRED_PROVIDER_virtual/libgbm = "ti-sgx-ddk-um"
PREFERRED_PROVIDER_virtual/gpudriver = "ti-sgx-ddk-km"
PREFERRED_PROVIDER_virtual/libgbm = "ti-sgx-ddk-um"

# Let user use his own preferences
DISTRO_FEATURES:remove = "opengl wayland x11"

DISTRO_FEATURES:append = " egl gles gles1 gles2 gbm gpu"
MACHINE_FEATURES:prepend = "gpu "

DISTRO_EXTRA_RDEPENDS:append = " ti-sgx-ddk-km ti-sgx-ddk-um"
```

## src/meta-user/conf/distro/beagle-soft-gpu.conf
```bitbake
# Use common config
require beagle-common.conf

DISTRO = "beagle-soft-gpu"
DISTRO_NAME = "Beaglebone with software GPU"

DISTRO_VERSION = "1.0.0"

PREFERRED_PROVIDER_virtual/mesa = "mesa"
PREFERRED_PROVIDER_virtual/egl = "mesa"
PREFERRED_PROVIDER_virtual/libgles1 = "mesa"
PREFERRED_PROVIDER_virtual/libgles2 = "mesa"
PREFERRED_PROVIDER_virtual/libgbm = "mesa"
PREFERRED_PROVIDER_virtual/libgl = "mesa"

DISTRO_FEATURES += "opengl x11 egl gles1 gles2 gbm"
```

## src/meta-user/conf/distro/mq-quad-common.conf
```bitbake
# We are extending poky
require conf/distro/poky.conf

DISTRO = "mq-quad-common"
DISTRO_NAME = "mq-quad-common"

DISTRO_VERSION = "1.0.0"

PREFERRED_VERSION_linux-mainline = "6.%"

# systemd
DISTRO_FEATURES:append = " systemd usrmerge"
DISTRO_FEATURES:remove = "vulkan wayland ptest"

INIT_MANAGER = "systemd"
```

## src/meta-user/conf/distro/orangepi.conf
```bitbake
# We are extending poky
require conf/distro/poky.conf

DISTRO = "orangepi"
DISTRO_NAME = "orangepi"

DISTRO_VERSION = "1.0.0"

PREFERRED_VERSION_linux-mainline = "6.%"

# systemd
DISTRO_FEATURES:append = " systemd usrmerge"
DISTRO_FEATURES:remove = "vulkan wayland ptest"

INIT_MANAGER = "systemd"
```

## src/meta-user/conf/machine/banan.conf
```bitbake
#@TYPE: Machine
#@NAME: Banan
#@DESCRIPTION: Machine based on beaglebone-yocto

DISTRO = "banan-common"

MACHINEOVERRIDES .= ":use-mailine-graphics"
MACHINEOVERRIDES .= ":bananapi"

require conf/machine/bananapi.conf

DEFAULTTUNE = "cortexa7hf-neon-vfpv4"

MACHINE_FEATURES:append = " onewire spidev"

XSERVER = "xserver-xorg xf86-video-modesetting"
```

## src/meta-user/conf/machine/bananapi-zero.conf
```bitbake
#@TYPE: Machine
#@NAME: Banan
#@DESCRIPTION: Banana PI BPI-M2 Zero

DISTRO_FEATURES += "wifi"
MACHINEOVERRIDES .= ":use-mailine-graphics"

require conf/machine/include/sun8i.inc
require conf/machine/include/hardware/ap6212a.inc

MACHINE_FEATURES += "wifi"
MACHINE_FEATURES:remove = "alsa bluetooth keyboard pulseaudio usbgadget qemu-usermode"

DEFAULTTUNE = "cortexa7hf-neon-vfpv4"
# There is support directly in kernel
KERNEL_DEVICETREE = "allwinner/sun8i-h2-plus-bananapi-m2-zero.dtb"
# There is support directly and uboot
UBOOT_MACHINE = "bananapi_m2_zero_defconfig"

XSERVER = "xserver-xorg xf86-video-modesetting"

IMAGE_FSTYPES:remove = "tar.gz wic.gz wic.bmap ext3"
# Mender configuration

IMAGE_INSTALL:append = " kernel-image kernel-devicetree"

IMAGE_BOOT_FILES = "${KERNEL_IMAGETYPE}"

MENDER_IMAGE_BOOTLOADER_FILE="u-boot-sunxi-with-spl.bin"
MENDER_IMAGE_BOOTLOADER_BOOTSECTOR_OFFSET="16"

ARTIFACTIMG_FSTYPE = "ext4"

# Mender features
MENDER_FEATURES_ENABLE = " mender-image mender-client-install mender-uboot mender-image-sd"

# Total size
MENDER_STORAGE_TOTAL_SIZE_MB = "4096"
# Persistent data size
MENDER_DATA_PART_SIZE_MB = "3072"

MENDER_ARTIFACT_NAME = "0.1.1"

MENDER_SERVER_URL = "https://eu.hosted.mender.io"
MENDER_TENANT_TOKEN = "eyJhbGciOiJSUzI1NiIsInR5cCI6IkpXVCJ9.eyJtZW5kZXIudGVuYW50IjoiNjRhNTg5ODkwMmNmY2MxODQ1YTQwNWM3IiwiaXNzIjoiTWVuZGVyIiwic3ViIjoiNjRhNTg5ODkwMmNmY2MxODQ1YTQwNWM3In0.CKh5dXmFBF1xU6g2SjjJ9VnaHU2ka0-XkCzIWkGzKHaSUt2fys5GnoKx4q4UcwtSCiLxjPmfmfFtYzrM1HaEg6Tts7aORB0fGNxudvAarAHvt1C-K3qa-Kcu9mWNlmN5W-6iFPJUym3XnucZVindZxcu7RshnL-NRFmZtyP66_-4hRR7Nh2mpxiR7IXaMuvyPvmMQXW8M-TR6A12nFXD__mcVk2onEP34pBIJoZRhpLJqvP5QJ42_DW8_E5LsZ32e4yi98RiwAeZkAiIEyFhVOXjiPDtVf_0_9beoyZfgqdilCoVnLPkueiVzAyqxN7NnLDX2ZusKcIwD-_z9kM7hnaaNTHAeM0SoyMRbbAFoODV6UYchJ4e7GEqHfLAuAJ5QRGLFBvPpVclLhXUEIP59CYPNRNC0IAbrgF9K2YwnK_CnvHIx1YTrhakioq3wafS7VN4a0CS7XuCDS9aGse8QhoX7wTtvVPEsgEjDfOe3GcUFJWFtGhIosYkKCxQqZDo"
```

## src/meta-user/conf/machine/beaglebone.conf
```bitbake
#@TYPE: Machine
#@NAME: Beaglebone
#@DESCRIPTION: Machine based on beaglebone-yocto

DISTRO = "beagle-common"

MACHINEOVERRIDES .= ":beaglebone-yocto"
require conf/machine/beaglebone-yocto.conf

PREFERRED_PROVIDER_virtual/kernel = "linux-yocto-rt"
PREFERRED_VERSION_linux-yocto-rt = "5.15%"

KERNEL_DEVICETREE = "am335x-bone.dtb am335x-boneblack.dtb"

MACHINE_FEATURES:remove = "usbgadget usbhost alsa"
MACHINE_FEATURES:append = " onewire spidev"
```

## src/meta-user/conf/machine/mq-quad.conf
```bitbake
#@TYPE: Machine
#@NAME: MQQuad
#@DESCRIPTION: Machine configuration for the MQQUAD H618

require conf/machine/include/sun50i-h616.inc

KERNEL_DEVICETREE = "sun50i-h618-orangepi-zero3.dtb"
UBOOT_MACHINE = "mq_quad_defconfig"

SPL_BINARY = "u-boot-sunxi-with-spl.bin"

# as for now neither graphics nor audio is supported
MACHINE_FEATURES:remove = "alsa x11"
MACHINE_FEATURES:append = "bluetooth wifi"

MACHINE_EXTRA_RRECOMMENDS = "uwe5622-firmware"

MENDER_FEATURES_ENABLE = " " 
```
